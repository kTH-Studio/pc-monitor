#include "display.h"
#include "lang.h"

//  Объекты U8g2

// Большой OLED — soft I2C (25/26)
static U8G2_SSD1306_128X64_NONAME_F_SW_I2C
    u8g2_big(U8G2_R0, PIN_SOFT_SCL, PIN_SOFT_SDA, U8X8_PIN_NONE);

// Малый OLED — аппаратный I2C (21/22)
static U8G2_SSD1306_128X32_UNIVISION_F_HW_I2C
    u8g2_small(U8G2_R0, U8X8_PIN_NONE);

//  Boot-состояние

struct BootCheck {
    const char* name;
    bool        ok;
    bool        done;
};

static BootCheck bootChecks[] = {
    { "OLED64",  false, false },
    { "OLED32",  false, false },
    { "BME280",  false, false },
    { "LDR",     false, false },
    { "BTN x5",  false, false },
    { "LED x5",  false, false },
    { "WiFi",    false, false },
    { "Web",     false, false },
};
static const uint8_t BOOT_CHECKS_COUNT = sizeof(bootChecks) / sizeof(bootChecks[0]);
static uint8_t bootIdx = 0;
static uint32_t bootAnimLast = 0;
static bool bootAnimOn = true;

//  Инициализация

void display_init() {
    Wire.begin(PIN_I2C_SDA, PIN_I2C_SCL);

    u8g2_big.begin();
    u8g2_big.setContrast(255);

    u8g2_small.begin();
    u8g2_small.setContrast(255);

    u8g2_big.clearBuffer();
    u8g2_big.sendBuffer();

    u8g2_small.clearBuffer();
    u8g2_small.sendBuffer();

    Serial.println("[DISPLAY] both OLEDs initialized");

        // Проверка OLED64
    Wire.beginTransmission(OLED64_ADDR);
    bool ok64 = (Wire.endTransmission() == 0);
    extern void boot_check_oled64(bool);
    boot_check_oled64(ok64);

    // Проверка OLED32
    Wire.beginTransmission(OLED32_ADDR);
    bool ok32 = (Wire.endTransmission() == 0);
    extern void boot_check_oled32(bool);
    boot_check_oled32(ok32);
}

//  Доступ

U8G2* display_big()   { return &u8g2_big; }
U8G2* display_small() { return &u8g2_small; }

void display_big_clear()   { u8g2_big.clearBuffer(); }
void display_big_send()    { u8g2_big.sendBuffer(); }
void display_small_clear() { u8g2_small.clearBuffer(); }
void display_small_send()  { u8g2_small.sendBuffer(); }

//  Яркость (контраст SSD1306 0..255)

void display_set_brightness(uint8_t pct) {
    if (pct > 100) pct = 100;
    uint8_t v = (uint16_t)pct * 255 / 100;
    u8g2_big.setContrast(v);
    u8g2_small.setContrast(v);
}

void display_set_night_brightness(uint8_t pct) {
    if (pct > 100) pct = 100;
    if (pct < 1) pct = 1;
    uint8_t v = (uint16_t)pct * 255 / 100;
    u8g2_big.setContrast(v);
    u8g2_small.setContrast(v);
}

//  BOOT — инициализация

void display_boot_init_begin() {
    bootIdx = 0;
    for (uint8_t i = 0; i < BOOT_CHECKS_COUNT; i++) {
        bootChecks[i].ok   = false;
        bootChecks[i].done = false;
    }
    bootAnimLast = millis();
    bootAnimOn   = true;
}

// Вызывается из основного loop — рисует текущее состояние
void display_boot_init_update() {
    // Анимация точек (раз в 500 мс)
    uint32_t now = millis();
    if (now - bootAnimLast > 500) {
        bootAnimOn = !bootAnimOn;
        bootAnimLast = now;
    }

    // БОЛЬШОЙ
    u8g2_big.clearBuffer();
    u8g2_big.setFont(FONT_BIG_NORMAL);
    u8g2_big.drawStr(0, 10, T(S_BOOT_TITLE));
    u8g2_big.drawHLine(0, 12, 128);

    // Список проверок
    uint8_t y = 22;
    for (uint8_t i = 0; i < BOOT_CHECKS_COUNT; i++) {
        if (y > 54) break;

        // Имя
        char line[24];
        snprintf(line, sizeof(line), "%-8s:", bootChecks[i].name);
        u8g2_big.drawStr(0, y, line);

        // Статус
        const char* st;
        if (!bootChecks[i].done) {
            st = bootChecks[i].ok ? T(S_OK) : T(S_WAIT);
        } else {
            st = bootChecks[i].ok ? T(S_OK) : T(S_FAIL);
        }
        u8g2_big.drawStr(74, y, st);

        // Анимация для текущей
        if (!bootChecks[i].done && bootAnimOn) {
            u8g2_big.drawStr(118, y, ".");
        }

        y += 5;
    }

    // Прогресс-бар
    uint8_t done = 0;
    for (uint8_t i = 0; i < BOOT_CHECKS_COUNT; i++) {
        if (bootChecks[i].done) done++;
    }
    uint8_t pct = (uint16_t)done * 100 / BOOT_CHECKS_COUNT;
    u8g2_big.drawFrame(0, 56, 100, 8);
    uint8_t fill = (uint16_t)pct * 98 / 100;
    if (fill > 0) u8g2_big.drawBox(1, 57, fill, 6);

    char buf[8];
    snprintf(buf, sizeof(buf), "%d%%", pct);
    u8g2_big.drawStr(104, 63, buf);

    u8g2_big.sendBuffer();

    // МАЛЫЙ
    u8g2_small.clearBuffer();
    u8g2_small.setFont(FONT_SMALL);

    // Строка 1: BOOT + прогресс
    snprintf(buf, sizeof(buf), "BOOT %d%%", pct);
    u8g2_small.drawStr(0, 7, buf);

    // Строка 2: климат с BME280 (если уже работает)
    extern bool sensors_bme_ok();
    extern float sensors_temp();
    extern float sensors_hum();
    extern float sensors_press_mm();

    if (sensors_bme_ok()) {
        char cl[40];
        snprintf(cl, sizeof(cl), "BME: %.1fC %.0f%% %.0fmm",
                 sensors_temp(), sensors_hum(), sensors_press_mm());
        u8g2_small.drawStr(0, 17, cl);
    } else {
        u8g2_small.drawStr(0, 17, "BME: --");
    }

    // Строка 3: IP (если WiFi поднялся)
    extern String webserver_get_ip();
    String ip = webserver_get_ip();
    if (ip.length() > 0) {
        char wl[40];
        snprintf(wl, sizeof(wl), "Web: %s", ip.c_str());
        u8g2_small.drawStr(0, 27, wl);
    } else {
        u8g2_small.drawStr(0, 27, "Web: --");
    }

    u8g2_small.sendBuffer();
}

// Отметить проверку как выполненную
static void boot_mark(const char* name, bool ok) {
    for (uint8_t i = 0; i < BOOT_CHECKS_COUNT; i++) {
        if (strcmp(bootChecks[i].name, name) == 0) {
            bootChecks[i].ok   = ok;
            bootChecks[i].done = true;
            return;
        }
    }
}

// Публичные функции для отметки из других модулей
extern "C" {
    void boot_check_oled64(bool ok)  { boot_mark("OLED64",  ok); }
    void boot_check_oled32(bool ok)  { boot_mark("OLED32",  ok); }
    void boot_check_bme(bool ok)     { boot_mark("BME280",  ok); }
    void boot_check_ldr(bool ok)     { boot_mark("LDR",     ok); }
    void boot_check_btns(bool ok)    { boot_mark("BTN x5",  ok); }
    void boot_check_leds(bool ok)    { boot_mark("LED x5",  ok); }
    void boot_check_wifi(bool ok)    { boot_mark("WiFi",    ok); }
    void boot_check_web(bool ok)     { boot_mark("Web",     ok); }
}

bool display_boot_done() {
    for (uint8_t i = 0; i < BOOT_CHECKS_COUNT; i++) {
        if (!bootChecks[i].done) return false;
    }
    return true;
}

//  BOOT — логотип

// Логотип — XBM-массив 128×64 (заглушка, заменишь своим)
static const uint8_t LOGO_BITS[] PROGMEM = {
    const uint8_t LOGO_BITS [] = {
  0x00, 0x00, 0x00, 0x00, 0x00, 0x00, 0x00, 0x00, 0x00, 0x00, 0x00, 0x00, 0x00, 0x00, 0x00, 0x00, 
  0x00, 0x00, 0x00, 0x00, 0x00, 0x00, 0x00, 0x00, 0x00, 0x00, 0x00, 0x00, 0x00, 0x00, 0x00, 0x00, 
  0x00, 0x00, 0xe0, 0x00, 0x00, 0x00, 0x00, 0x00, 0x00, 0x00, 0x00, 0x00, 0x00, 0x00, 0x00, 0x00, 
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  0x00, 0x00, 0x01, 0xff, 0x00, 0x00, 0x1f, 0x80, 0x00, 0x00, 0x00, 0x00, 0x00, 0x00, 0x00, 0x00
};

const int LOGO_BITSallArray_LEN = 1;
const uint8_t* LOGO_BITSallArray[1] = {
  LOGO_BITS
};

};

void display_logo_show() {
    // БОЛЬШОЙ: логотип
    u8g2_big.clearBuffer();
    // Если логотип задан — рисуем
    u8g2_big.drawXBMP(0, 0, 128, 64, LOGO_BITS);
    // Пока — заглушка "KTH"
    //u8g2_big.setFont(FONT_BIG_HUGE);
    //u8g2_big.drawStr(30, 45, "KTH");
    u8g2_big.sendBuffer();

    // МАЛЫЙ: инфо-карточка
    u8g2_small.clearBuffer();
    u8g2_small.setFont(FONT_SMALL);

    char line[40];
    snprintf(line, sizeof(line), "%s  v.%s", FW_NAME, FW_VERSION);
    u8g2_small.drawStr(0, 7, line);

    snprintf(line, sizeof(line), "by %s", FW_AUTHOR);
    u8g2_small.drawStr(0, 15, line);

    // Статус
    extern bool comms_is_linked();
    const char* st = comms_is_linked() ? T(S_READY) : T(S_WAIT_DATA);
    u8g2_small.drawStr(0, 23, st);

    // IP
    extern String webserver_get_ip();
    String ip = webserver_get_ip();
    if (ip.length() > 0) {
        snprintf(line, sizeof(line), "ip: %s", ip.c_str());
    } else {
        snprintf(line, sizeof(line), "ip: --");
    }
    u8g2_small.drawStr(0, 31, line);

    u8g2_small.sendBuffer();

    Serial.println("[DISPLAY] logo shown");
}
